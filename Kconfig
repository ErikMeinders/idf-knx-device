## Kconfig
```kconfig
menu "KNX device (idf-knx-device)"

    choice KNX_MASK
        prompt "KNX device profile (mask version)"
        default KNX_MASK_57B0
        help
            The KNX system profile this device reports to ETS. It must match
            the MaskVersion of the ETS product database (.knxprod) used to
            commission the device.

        config KNX_MASK_57B0
            bool "0x57B0 - KNX IP device (routing over Wi-Fi/Ethernet)"
    endchoice

    config KNX_MASK_VERSION
        hex
        default 0x57B0 if KNX_MASK_57B0

    config KNX_FLASH_SIZE
        int "Configuration storage size (bytes)"
        range 1024 65536
        default 4096
        help
            Size of the buffer holding everything ETS downloads (address,
            association and group object tables plus the application
            parameters). It is persisted as a single NVS blob, so it must also
            fit in the application's NVS partition.

            Changing it on a commissioned device discards the stored
            configuration (size mismatch), so the device has to be downloaded
            from ETS again.

    config KNX_IGMP_REFRESH_S
        int "Renew the multicast membership every (seconds, 0 = never)"
        range 0 3600
        default 20
        help
            How often the platform sends a fresh IGMP report for the KNX
            multicast group, while the socket stays open.

            Without an IGMP querier on the network, Wi-Fi access points and
            mesh systems (seen on a TP-Link Deco) stop forwarding multicast to
            a station at random moments, for up to minutes. A report makes them
            resume within seconds, so the interval caps how long the device
            can be deaf. Each renewal sends one small IGMP report per multicast
            group the interface has joined (the KNX group, plus mDNS and any
            others), and no IGMP Leave.

endmenu
```

## examples/ip_device_demo/main/Kconfig.projbuild
```kconfig
menu "KNX IP device demo"

    config DEMO_WIFI_SSID
        string "Wi-Fi SSID"
        default "myssid"

    config DEMO_WIFI_PASSWORD
        string "Wi-Fi password"
        default "mypassword"

    config DEMO_PROG_BUTTON_GPIO
        int "Programming button GPIO (-1 to disable)"
        range -1 48
        default 9 if IDF_TARGET_ESP32C6 || IDF_TARGET_ESP32C3 || IDF_TARGET_ESP32H2
        default 0
        help
            Active-low push button that toggles KNX programming mode. The
            default is the BOOT button on Espressif DevKits.

    config DEMO_PROG_LED_GPIO
        int "Programming LED GPIO (-1 to disable)"
        range -1 48
        default -1
        help
            Plain LED that is lit while the device is in programming mode.
            Addressable (WS2812) LEDs need their own driver; use
            setProgLedOnCallback()/setProgLedOffCallback() for those.

    config DEMO_PROG_LED_ACTIVE_HIGH
        bool "Programming LED is active high"
        depends on DEMO_PROG_LED_GPIO >= 0
        default y

endmenu
```
